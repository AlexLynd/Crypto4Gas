// ESP Pro Library
#include "./esppl_functions.h"

// base64 for ghetto compression
#include "base64.hpp"

// OLED shit
#include <SPI.h>
#include <Wire.h>
#include <Adafruit_GFX.h>
#include <Adafruit_SSD1306.h>

// NRF24
#include <RF24Network.h>
#include <RF24.h>

Adafruit_SSD1306 display(128, 64, &Wire, -1);  // shared reset

RF24 radio(D3, D4); 
RF24Network network(radio); 

#define scrnToggle D0
int toggleState = 0; 
int prevToggleState = 0;  

const uint16_t this_node = 01; // change this value to a unique number for every node
const uint16_t base_node = 00;  // stationary node, unless using an intermediate node (usually 0)

byte bitch[62]; // NRF24L01 network packet

byte mac[6];  
unsigned char macHex[8];
unsigned char srcHex[8];
unsigned char dstHex[8];

unsigned char numGroup[4];
unsigned char ngHex[6]; // trim off last 2 bytes to save space

const unsigned char lyndlabs_logo[] PROGMEM = {
  0x00,0x00,0x00,0x00,0x00,0x00,0x00,0x01,0x00,0x00,0x00,0x00,0x00,0x00,0x00,0x00,
  0x00,0x00,0x00,0x00,0x00,0x00,0x00,0x07,0xC0,0x00,0x00,0x00,0x00,0x00,0x00,0x00,
  0x00,0x00,0x00,0x00,0x00,0x00,0x00,0x1F,0xF0,0x00,0x00,0x00,0x00,0x00,0x00,0x00,
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  0x00,0x00,0x00,0x00,0x00,0x00,0x00,0x01,0x00,0x00,0x00,0x00,0x00,0x00,0x00,0x00
};

void cb(esppl_frame_info *info) { // get packet and contstruct JSON to send over NRF24
    
    // Number Grouping
    numGroup[0] = abs(info->rssi);
    numGroup[1] = info->channel;
    numGroup[2] = info->frametype;
    numGroup[3] = info->framesubtype;
    encode_base64(numGroup, 4, ngHex); for(int i=0; i<sizeof(ngHex); i++){ bitch[25+i] = ngHex[i]; }

    for (int i= 0; i<32; i++) { bitch[31+i]= '+'; }
    if (info->ssid_length > 0) {
      for (int i= 0; i< info->ssid_length; i++) { bitch[31+i]= (char) info->ssid[i]; }
    }

    // MAC address grouping 
    WiFi.macAddress(mac);
    encode_base64(mac, 6, macHex);                    for(int i=0; i<sizeof(macHex); i++){ bitch[i] = macHex[i]; }
    encode_base64(info->sourceaddr, 6, srcHex);       for(int i=0; i<sizeof(srcHex); i++){ bitch[8+i] = srcHex[i]; }
    encode_base64(info->receiveraddr, 6, dstHex);     for(int i=0; i<sizeof(dstHex); i++){ bitch[16+i] = dstHex[i]; }

    network.update(); // NRF24 network
    RF24NetworkHeader header2(base_node);     // (Address where the data is going)
    network.write(header2, &bitch, sizeof(bitch));

//    toggleState = digitalRead(scrnToggle);
//    if (!toggleState) {
//      Serial.println("low");
//      updateDisplay();
//      prevToggleState = toggleState;
//    }
//    else if (toggleState and toggleState!= prevToggleState) {
//      Serial.println("bounced");
//      display.clearDisplay();
//      display.display();
//    }

//    Serial.println(ESP.getFreeHeap());

}

void setup() {
  delay(500); 
  Serial.begin(115200);
  pinMode(scrnToggle, INPUT);
  esppl_init(cb);
  oled_init();
//  web_init(); // add web config later
  nrf24_init(); 
  scan_init();
  updateDisplay();

}

void loop() {
  esppl_sniffing_start();
  while (true) {
    for (int i = 1; i < 15; i++ ) {
      esppl_set_channel(i);
      while (esppl_process_frames()) {
        //
      }
    }
  }  
}

void oled_init() {
  if(!display.begin(SSD1306_SWITCHCAPVCC, 0x3C)) { // address 0x3C
    Serial.println(F("SSD1306 allocation failed"));
    for(;;);
  }

  display.clearDisplay();
  display.drawBitmap(0,0,lyndlabs_logo,128,64,WHITE);
  display.display();
  delay(500);
  display.clearDisplay();
  display.setTextSize(2);
  display.setTextColor(WHITE);
  display.setCursor(5, 10);
  display.println("Crypto4Gas");
  display.setTextSize(1);
  display.setCursor(28, 40);
  display.println("Prototype V1");
  display.setCursor(25, 50);
  display.println("LyndLabs 2021");
  display.display();
  delay(500);
  display.clearDisplay();
  display.display();
  display.setCursor(5,0);
  display.println("*Crypto4Gas Startup*\n");
}

void nrf24_init() {
  display.println("[-] initialize NRF24");
  display.display();    
  radio.begin();
  network.begin(90, this_node);  //(channel, node address)
  radio.setDataRate(RF24_2MBPS);
  delay(100);
  display.print("[-] started Node ");
  display.println(this_node);
  display.display();
}

void scan_init() {
  delay(100);
  display.println("[-] initialize WiFi");
  display.display();    
  delay(100);
  display.println();
  display.print(WiFi.macAddress());
  display.display();    
  delay(1000);
  display.clearDisplay();
  display.setCursor(0,0);
  display.println("Shutting screen off");
  display.println("to conserve power.");
  display.println("Enable switch on GPIO");
  display.println("0 to get readout.");
  display.println();
  display.println("Starting scan...");
  display.display();
  delay(3000);
  display.clearDisplay();
  display.display();  
}

//void updateDisplay() {
//    display.setCursor(0,0);
//    display.println(WiFi.macAddress());
//    display.print("NRF 24 Node ");
//    display.println(this_node);
//    display.println();
//    display.println("this screen should not be kept on.");
//    display.display();
//}

void updateDisplay() {
  display.setCursor(28,28);
  display.setTextSize(2);
  display.print("Node ");
  display.println(this_node);
  display.display();
}
